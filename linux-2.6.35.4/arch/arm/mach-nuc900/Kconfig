## linux-2.6.35.4/arch/arm/mach-nuc900/Kconfig
```kconfig
if ARCH_W90X900

config CPU_W90P910
	bool
	help
	  Support for NUC910 of Nuvoton W90X900 CPUs.

config CPU_NUC950
	bool
	help
	  Support for NUC950 of Nuvoton NUC900 CPUs.

config CPU_NUC960
	bool
	help
	  Support for NUC960 of Nuvoton NUC900 CPUs.

menu "NUC910 Machines"

config MACH_W90P910EVB
	bool "Nuvoton NUC910 Evaluation Board"
	default y
	select CPU_W90P910
	help
	   Say Y here if you are using the Nuvoton NUC910 EVB

endmenu

menu "NUC950 Machines"

config MACH_W90P950EVB
	bool "Nuvoton NUC950 Evaluation Board"
	select CPU_NUC950
	help
	   Say Y here if you are using the Nuvoton NUC950 EVB

endmenu

menu "NUC960 Machines"

config MACH_W90N960EVB
	bool "Nuvoton NUC960 Evaluation Board"
	select CPU_NUC960
	help
	   Say Y here if you are using the Nuvoton NUC960 EVB

endmenu

endif
```
